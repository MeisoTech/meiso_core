## targets/k230d/sdk-overlay/src/applications/meiso_conformance/Kconfig
```kconfig
config APP_ENABLE_MEISO_CONFORMANCE
    bool "Enable Meiso Resource Core conformance"
    default n
    help
      Build the bounded, manually invoked Meiso Resource Core conformance ELF.
      This option does not register an MSH command or enable automatic start.
```
